## firmware_s3logger/sdkconfig.defaults
```kconfig
CONFIG_IDF_TARGET="esp32s3"
CONFIG_ESPTOOLPY_FLASHSIZE_16MB=y
CONFIG_FREERTOS_HZ=1000
# USB ポートはホストとして使うので、ログは UART0 に出す
CONFIG_ESP_CONSOLE_UART_DEFAULT=y
# microSD に長いファイル名（s3_20261124_120000_frames.csv など）を使う
CONFIG_FATFS_LFN_HEAP=y
CONFIG_FATFS_MAX_LFN=255
```
